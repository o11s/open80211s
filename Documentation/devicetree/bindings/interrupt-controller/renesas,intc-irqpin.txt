## Documentation/devicetree/bindings/interrupt-controller/renesas,intc-irqpin.txt
```
DT bindings for the R-/SH-Mobile irqpin controller

Required properties:

- compatible: has to be "renesas,intc-irqpin"
- #interrupt-cells: has to be <2>

Optional properties:

- any properties, listed in interrupts.txt in this directory, and any standard
  resource allocation properties
- control-parent: disable and enable interrupts on the parent interrupt
  controller, needed for some broken implementations
```

## Documentation/devicetree/bindings/mailbox/dbx500-mailbox.txt
```
ST-Ericsson DBx500 PRCM Mailbox Driver

Required properties:
- compatible		: Should be
			  "stericsson,db8500-mailbox" for db8500 and db9500
			  "stericsson,db9540-mailbox" for db9540
- reg			: Physical base address and length of mailbox's
			  registers and shared memory
- reg-names		: Should contain the reg names "prcm-reg" and
			  "prcmu-tcdm"
- interrupts		: contains the IRQ line for the PRCM mailbox
- interrupt-names	: Should contain the interrupt name "irq"
- legacy-offset		: Memory offset in shared mem for legacy mailboxes

Optional properties:
- upap-offset		: Memory offset in shared mem for upap mailboxes

Examples:

mailbox {
	compatible = "stericsson,db8500-mailbox";
	reg = <0x80157000 0x1000>, <0x801B8000 0x2000>;
	reg-names = "prcm-reg", "prcmu-tcdm";
	interrupts = <0 47 0x4>;
	interrupt-names = "irq";
	legacy-offset = <0xdd4>;
};
```

## Documentation/devicetree/bindings/tty/serial/renesas,sci-serial.txt
```
* Renesas SH-Mobile Serial Communication Interface

Required properties:
- compatible : Should be "renesas,sci-<port type>-uart", where <port type> may be
  SCI, SCIF, IRDA, SCIFA or SCIFB.
- reg : Address and length of the register set for the device
- interrupts : Should contain the following IRQs: ERI, RXI, TXI and BRI.
- cell-index : The device id.
- renesas,scscr : Should contain a bitfield used by the Serial Control Register.
  b7 = SCSCR_TIE
  b6 = SCSCR_RIE
  b5 = SCSCR_TE
  b4 = SCSCR_RE
  b3 = SCSCR_REIE
  b2 = SCSCR_TOIE
  b1 = SCSCR_CKE1
  b0 = SCSCR_CKE0
- renesas,scbrr-algo-id : Algorithm ID for the Bit Rate Register
  1 = SCBRR_ALGO_1 ((clk + 16 * bps) / (16 * bps) - 1)
  2 = SCBRR_ALGO_2 ((clk + 16 * bps) / (32 * bps) - 1)
  3 = SCBRR_ALGO_3 (((clk * 2) + 16 * bps) / (16 * bps) - 1)
  4 = SCBRR_ALGO_4 (((clk * 2) + 16 * bps) / (32 * bps) - 1)
  5 = SCBRR_ALGO_5 (((clk * 1000 / 32) / bps) - 1)

Optional properties:
- renesas,autoconf : Set if device is capable of auto configuration
- renesas,regtype : Overwrite the register layout. In most cases you can rely
  on auto-probing (omit this property or set to 0) but some legacy devices
  use a non-default register layout. Possible layouts are
  0 = SCIx_PROBE_REGTYPE (default)
  1 = SCIx_SCI_REGTYPE
  2 = SCIx_IRDA_REGTYPE
  3 = SCIx_SCIFA_REGTYPE
  4 = SCIx_SCIFB_REGTYPE
  5 = SCIx_SH2_SCIF_FIFODATA_REGTYPE
  6 = SCIx_SH3_SCIF_REGTYPE
  7 = SCIx_SH4_SCIF_REGTYPE
  8 = SCIx_SH4_SCIF_NO_SCSPTR_REGTYPE
  9 = SCIx_SH4_SCIF_FIFODATA_REGTYPE
 10 = SCIx_SH7705_SCIF_REGTYPE


Example:
	sci@0xe6c50000 {
		compatible = "renesas,sci-SCIFA-uart";
		interrupt-parent = <&intca>;
		reg = <0xe6c50000 0x100>;
		interrupts = <0x0c20>, <0x0c20>, <0x0c20>, <0x0c20>;
		cell-index = <1>;
		renesas,scscr = <0x30>;
		renesas,scbrr-algo-id = <4>;
		renesas,autoconf;
	};
```

## drivers/mailbox/Kconfig
```kconfig
menuconfig MAILBOX
	bool "Mailbox Hardware Support"
	help
	  Mailbox is a framework to control hardware communication between
	  on-chip processors through queued messages and interrupt driven
	  signals. Say Y if your platform supports hardware mailboxes.

if MAILBOX
config PL320_MBOX
	bool "ARM PL320 Mailbox"
	depends on ARM_AMBA
	help
	  An implementation of the ARM PL320 Interprocessor Communication
	  Mailbox (IPCM), tailored for the Calxeda Highbank. It is used to
	  send short messages between Highbank's A9 cores and the EnergyCore
	  Management Engine, primarily for cpufreq. Say Y here if you want
	  to use the PL320 IPCM support.

config OMAP1_MBOX
       tristate "OMAP1 Mailbox framework support"
       depends on ARCH_OMAP1
       help
         Mailbox implementation for OMAP chips with hardware for
         interprocessor communication involving DSP in OMAP1. Say Y here
         if you want to use OMAP1 Mailbox framework support.

config OMAP2PLUS_MBOX
       tristate "OMAP2+ Mailbox framework support"
       depends on ARCH_OMAP2PLUS
       help
         Mailbox implementation for OMAP family chips with hardware for
         interprocessor communication involving DSP, IVA1.0 and IVA2 in
         OMAP2/3; or IPU, IVA HD and DSP in OMAP4. Say Y here if you want
         to use OMAP2+ Mailbox framework support.

config DBX500_MBOX
	tristate "DBx500 Mailbox driver support"
	depends on ARCH_U8500
	help
	  Say Y here if you want to use DBx500 Mailbox driver support for
	  power coprocessor access on Ux500 and Ux540 families

config MBOX_KFIFO_SIZE
       int "Mailbox kfifo default buffer size (bytes)"
       default 256
       help
         Specify the default size of mailbox's kfifo buffers (bytes).
         This can also be changed at runtime (via the mbox_kfifo_size
         module parameter).

config MBOX_DATA_SIZE
	int "Mailbox associated data max size (bytes)"
	default 64 if DBX500_MBOX
	default 4
	help
	  Specify the default size of mailbox's associated data buffer
	  (bytes)
          This can also be changed at runtime (via the mbox_kfifo_size
          module parameter).
endif
```

## drivers/net/wireless/mwl8787/Kconfig
```kconfig
config MWL8787
	tristate "Marvell 8787 SoftMAC SDIO support"
	depends on MMC && MAC80211
	select FW_LOADER
	help
	  This is a softmac driver for Marvell 8787 USB devices.

	  If unsure, say N.

config MWL8787_TRACER
	bool "Marvell 8787 SoftMAC SDIO tracer"
	depends on MWL8787
	depends on EVENT_TRACING
	---help---
	  Say Y here to enable tracepoints for the mwl8787 driver
	  using the kernel tracing infrastructure.  Select this
	  option if you are interested in debugging the driver.

	  If unsure, say N.
```
